## drivers/gpu/drm/colorctrl/Kconfig
```kconfig
# SPDX-License-Identifier: GPL-2.0
# OPLUS Color Control Drivers

menu "OPLUS Color Control"

source "drivers/gpu/drm/colorctrl/colorctrl/Kconfig"
source "drivers/gpu/drm/colorctrl/colorctrl_v2/Kconfig"

endmenu
```

## drivers/power/oplus_power/Kconfig
```kconfig
# SPDX-License-Identifier: GPL-2.0
# OPLUS Power Management Drivers

menu "OPLUS Power Management"

source "drivers/power/oplus_power/cpufreq_effiency/Kconfig"
source "drivers/power/oplus_power/cpufreq_health/Kconfig"
source "drivers/power/oplus_power/midas/Kconfig"
source "drivers/power/oplus_power/power_diag/Kconfig"

endmenu
```

## drivers/soc/oplus/performance/gloom_new/Kconfig
```kconfig
# SPDX-License-Identifier: GPL-2.0-only
# Copyright (C) 2018-2020 Oplus. All rights reserved.

config OPLUS_GLOOM_NEW
	tristate "OPLUS Gloom New Driver"
	default n
	help
	  OPLUS Gloom New performance optimization
```

## drivers/soc/oplus/performance/healthinfo/ion/Kconfig
```kconfig
# SPDX-License-Identifier: GPL-2.0
# OPLUS Healthinfo ION

config OPLUS_FEATURE_ION_HEALTHINFO
	bool "OPLUS ION Healthinfo"
	default n
	help
	  OPLUS ION memory health information tracking
```

## drivers/soc/oplus/performance/ion_boost_pool/Kconfig
```kconfig
# SPDX-License-Identifier: GPL-2.0-only
# Copyright (C) 2018-2020 Oplus. All rights reserved.

config OPLUS_ION_BOOST_POOL
	tristate "OPLUS ION Boost Pool"
	default n
	help
	  OPLUS ION memory boost pool management
```

## drivers/soc/oplus/performance/memleak_detect/Kconfig
```kconfig
# SPDX-License-Identifier: GPL-2.0
# OPLUS Memleak Detect Drivers

source "drivers/soc/oplus/performance/memleak_detect/svelte/Kconfig"
source "drivers/soc/oplus/performance/memleak_detect/task_mem/Kconfig"
source "drivers/soc/oplus/performance/memleak_detect/oppo_svelte/Kconfig"
source "drivers/soc/oplus/performance/memleak_detect/malloc_track/Kconfig"
```

## drivers/soc/oplus/performance/multi_freearea/Kconfig
```kconfig
# SPDX-License-Identifier: GPL-2.0-only
# Copyright (C) 2018-2020 Oplus. All rights reserved.

config OPLUS_MULTI_FREEAREA
	tristate "OPLUS Multi Freearea"
	default n
	help
	  OPLUS multi freearea memory management
```

## drivers/soc/oplus/performance/oplus_mm/Kconfig
```kconfig
# SPDX-License-Identifier: GPL-2.0
# OPLUS MM Drivers

source "drivers/soc/oplus/performance/oplus_mm/zram_opt/Kconfig"
source "drivers/soc/oplus/performance/oplus_mm/process_reclaim/Kconfig"
```

## drivers/soc/oplus/performance/process_reclaim/Kconfig
```kconfig
# SPDX-License-Identifier: GPL-2.0-only
# Copyright (C) 2018-2020 Oplus. All rights reserved.

config PROCESS_RECLAIM_ENHANCE
	bool "Process reclaim enhance"
	default n
	help
	  Support reclaim process inactive pages only
```

## drivers/soc/oplus/performance/vm_anti_fragment/Kconfig
```kconfig
# SPDX-License-Identifier: GPL-2.0-only
# Copyright (C) 2018-2020 Oplus. All rights reserved.

config OPLUS_VM_ANTI_FRAGMENT
	tristate "OPLUS VM Anti Fragment"
	default n
	help
	  OPLUS VM anti-fragmentation optimization
```

## drivers/soc/oplus/secureguard/Kconfig
```kconfig
# SPDX-License-Identifier: GPL-2.0
# OPLUS Security Drivers

menu "OPLUS Security"

source "drivers/soc/oplus/secureguard/keventupload/Kconfig"
source "drivers/soc/oplus/secureguard/rootguard/Kconfig"

endmenu
```

## drivers/soc/oplus/secureguard/keventupload/Kconfig
```kconfig
# SPDX-License-Identifier: GPL-2.0
# OPLUS Kevent Upload

config OPLUS_KEVENT_UPLOAD
	bool "OPLUS Kevent Upload Support"
	default y
	help
	  OPLUS kernel event upload feature for security monitoring
```

## drivers/soc/oplus/secureguard/rootguard/Kconfig
```kconfig
# SPDX-License-Identifier: GPL-2.0
# OPLUS Root Guard

config OPLUS_ROOT_GUARD
	bool "OPLUS Root Guard Support"
	default y
	help
	  OPLUS root protection and security monitoring feature
```

## sound/soc/oplus/Kconfig
```kconfig
# SPDX-License-Identifier: GPL-2.0
# OPLUS Audio Support

config SND_SOC_OPLUS_AUDIO_EXTEND
	tristate "OPLUS Audio Extension Driver"
	help
	  OPLUS audio extension driver for enhanced audio features.
```

## techpack/data/drivers/Kconfig
```kconfig
source "techpack/data/drivers/emac-dwc-eqos/Kconfig"
source "techpack/data/drivers/rmnet/Kconfig"
```
